#define CONFIG_WIRELESS
#define ZMK_BASE_LAYER(name, LT, RT, LM, RM, LB, RB, LH, RH)                   \
    ZMK_LAYER(                                                                 \
        name,                                                                  \
                 LT RT                                                         \
                 LM RM                                                         \
                 LB RB                                                         \
                 LH RH                                                         \
    )

#include "zmk-helpers/key-labels/34.h"
#include "base.keymap"

/{ chosen { zmk,physical-layout = &cuddlykeyboards_ferris_layout; }; };
